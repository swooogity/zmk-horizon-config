## config/boards/shields/horizon/Kconfig.defconfig
```kconfig
# Copyright (c) 2021 The ZMK Contributors
# SPDX-License-Identifier: MIT

if SHIELD_HORIZON

config ZMK_KEYBOARD_NAME
    default "Horizon"

CONFIG_EC11=y
CONFIG_EC11_TRIGGER_GLOBAL_THREAD=y

endif
```
